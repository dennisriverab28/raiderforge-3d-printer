#include "display.h"
#include "main.h"
#include "globals_m.h"
#include "u8g2.h"
#include "printer_config.h"   /* Printer_GetNozzleTemp, Printer_GetNozzleTarget */
#include "bed_heater.h"         /* BedHeater_GetTemp, BedHeater_GetTarget */
#include <stdio.h>


//this is the definition of the u8g2
u8g2_t u8g2;

//------------------------------------------------------------------------------------------------------------------------------------------------------------
//Bitmaps below here

//bitmap for telemetry
static const uint8_t image_clock_bits[] = {0xe0,0x03,0x18,0x0c,0x94,0x14,0x82,0x20,0x86,0x30,0x81,0x40,0x81,0x40,0x87,0x70,0x01,0x41,0x01,0x42,0x06,0x34,0x02,0x20,0x94,0x14,0x98,0x0c,0xe0,0x03,0x00,0x00};
static const uint8_t image_Layer_5_bits[] = {0x08,0x08,0x22,0x1c,0x08,0x22,0x2a,0x2a,0x00,0x00,0x00,0x00,0x00,0x00,0x00,0x00,0xff};
static const uint8_t image_Layer_6_bits[] = {0x92,0x49,0x92,0x49,0x92};
static const uint8_t image_micro_sd_bits[] = {0xfc,0x03,0x06,0x04,0x02,0x04,0x02,0x04,0xe2,0x0c,0x12,0x09,0xf2,0x11,0x02,0x10,0x92,0x08,0x52,0x09,0x22,0x11,0x02,0x10,0xe2,0x11,0x1a,0x16,0xec,0x0d,0x00,0x00};

//bitmap for menu screen
static const uint8_t image_crossed_bits[] = {0x00,0x00,0x00,0x00,0x03,0x06,0x07,0x07,0x8e,0x03,0xdc,0x01,0xf8,0x00,0x70,0x00,0xf8,0x00,0xdc,0x01,0x8e,0x03,0x07,0x07,0x03,0x06,0x00,0x00,0x00,0x00,0x00,0x00};
static const uint8_t image_download_1_bits[] = {0x80,0x00,0x48,0x01,0x38,0x02,0x98,0x04,0x48,0x09,0x24,0x12,0x12,0x24,0x09,0x48,0x66,0x30,0x64,0x10,0x04,0x17,0x04,0x15,0x04,0x17,0x04,0x15,0xfc,0x1f,0x00,0x00};
static const uint8_t image_download_2_bits[] = {0xe0,0x03,0x18,0x0c,0x04,0x10,0x02,0x20,0x32,0x20,0xd1,0x41,0x11,0x46,0x11,0x58,0x11,0x46,0xd1,0x41,0x32,0x20,0x02,0x20,0x04,0x10,0x18,0x0c,0xe0,0x03,0x00,0x00};
static const uint8_t image_download_3_bits[] = {0x9f,0x0f,0x91,0x08,0x91,0x08,0x91,0x08,0x91,0x08,0x91,0x08,0x91,0x08,0x91,0x08,0x91,0x08,0x91,0x08,0x91,0x08,0x91,0x08,0x91,0x08,0x91,0x08,0x9f,0x0f,0x00,0x00};
static const uint8_t image_download_bits[] = {0x38,0x00,0x44,0x40,0xd4,0xa0,0x54,0x40,0xd4,0x1c,0x54,0x06,0xd4,0x02,0x54,0x02,0x54,0x06,0x92,0x1c,0x39,0x01,0x75,0x01,0x7d,0x01,0x39,0x01,0x82,0x00,0x7c,0x00};
static const uint8_t image_Layer_11_bits[] = {0x1f,0x00,0x1f,0x01,0x00,0x10,0x01,0x00,0x10,0x01,0x00,0x10,0x01,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0x00,0x1f};
static const uint8_t image_menu_settings_gear_bits[] = {0xc0,0x03,0x48,0x12,0x34,0x2c,0x02,0x40,0xc4,0x23,0x24,0x24,0x13,0xc8,0x11,0x88,0x11,0x88,0x13,0xc8,0x24,0x24,0xc4,0x23,0x02,0x40,0x34,0x2c,0x48,0x12,0xc0,0x03};
static const uint8_t image_operation_undo_bits[] = {0x00,0x00,0x00,0x00,0x00,0x00,0xf1,0x01,0x0b,0x02,0x07,0x04,0x0f,0x08,0x1f,0x08,0x00,0x08,0x00,0x08,0x00,0x08,0x04,0x04,0x08,0x02,0xf0,0x01,0x00,0x00,0x00,0x00};

//bitmap for logo
static const uint8_t RaiderForgeLogo[] = {0x00,0x00,0x00,0x00,0x00,0x00,0x00,0x00,0x00,0x00,0x00,0x00,0x00,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0x00,0x00};

//------------------------------------------------------------------------------------------------------------------------------------------------------
//variables below here
int8_t menu_sel = 0;
static int16_t last_cnt = 0;

// selection box X positions (keeps 21px box on-screen)
static const uint8_t sel_box_x[MENU_COUNT] = {
    2, 20, 38, 56, 74, 92, 107
};

// This is used to show a string of what the has highlighted in the menu
static const char *sel_names[MENU_COUNT] = {
    "Return to Menu",
    "Settings",
    "Preheat",
    "Home Printer",
    "Start Print",
    "Cancel Print",
    "Pause Print"
};


uint8_t u8x8_byte_stm32_hw_spi(u8x8_t *u8x8, uint8_t msg, uint8_t arg_int, void *arg_ptr)
{
    switch (msg)
    {
        case U8X8_MSG_BYTE_INIT:
            return 1;

        case U8X8_MSG_BYTE_SET_DC:
            return 1;

        case U8X8_MSG_BYTE_START_TRANSFER:
            HAL_GPIO_WritePin(Screen_CS_GPIO_Port, Screen_CS_Pin, GPIO_PIN_SET);
            return 1;

        case U8X8_MSG_BYTE_SEND:
            HAL_SPI_Transmit(&hspi3, (uint8_t*)arg_ptr, arg_int, HAL_MAX_DELAY);
            return 1;

        case U8X8_MSG_BYTE_END_TRANSFER:
            HAL_GPIO_WritePin(Screen_CS_GPIO_Port, Screen_CS_Pin, GPIO_PIN_RESET);
            return 1;

        default:
            return 0;
    }
}


uint8_t u8x8_gpio_and_delay_stm32(u8x8_t *u8x8, uint8_t msg, uint8_t arg_int, void *arg_ptr)
{
    switch (msg)
    {
    case U8X8_MSG_DELAY_MILLI:
        HAL_Delay(arg_int);
        return 1;
    case U8X8_MSG_DELAY_10MICRO:
        for (volatile uint32_t i = 0; i < (SystemCoreClock/1000000/3)*10*arg_int; i++) { __NOP(); }
        return 1;

    case U8X8_MSG_GPIO_RESET:
        // If you wired RST, toggle it here. If not, just return 1.
        // HAL_GPIO_WritePin(Screen_RST_GPIO_Port, Screen_RST_Pin, arg_int ? GPIO_PIN_SET : GPIO_PIN_RESET);
        return 1;
    }
    return 1;
}

//-----------------------------------------------------------------------------------------------------------------------------------------
//Definitions start here

//this is used to initialize the screen
void init_display(void)
{
    // Choose the correct constructor variant for your wiring:
    // "sw_spi" = bit-banged, "hw_spi" = hardware SPI.
	u8g2_Setup_st7920_s_128x64_f(&u8g2, U8G2_R0, u8x8_byte_stm32_hw_spi, u8x8_gpio_and_delay_stm32);

    u8g2_InitDisplay(&u8g2);
    u8g2_SetPowerSave(&u8g2, 0);

    u8g2_SetBitmapMode(&u8g2, 1);
    u8g2_SetFontMode(&u8g2, 1);
    u8g2_SetFont(&u8g2, u8g2_font_6x10_tr);

    u8g2_ClearBuffer(&u8g2);
    u8g2_SendBuffer(&u8g2);
}


//used to show the telemetry screen
void telemetry_display(){
    /* ── Live temperature data from DDRlo ─────────────────────────────────
     * Printer_GetNozzleTemp/Target read DDRlo.hotend (same struct Heater
     * tasks write to). BedHeater_GetTemp reads the bed_heater static.
     * Both are updated by HeaterTask at 10Hz so always current.           */
    float he_actual  = Printer_GetNozzleTemp();
    float he_target  = Printer_GetNozzleTarget();
    float bed_actual = BedHeater_GetTemp();
    float bed_target = BedHeater_GetTarget();

    /* Format: "Ext Temp: 22/200" — actual/target, integer only to fit screen */
    char ext_buf[22];
    char bed_buf[22];
    snprintf(ext_buf, sizeof(ext_buf), "Ext Temp:%3d/%3d",
             (int)he_actual,  (int)he_target);
    snprintf(bed_buf, sizeof(bed_buf), "Bed Temp:%3d/%3d",
             (int)bed_actual, (int)bed_target);

	u8g2_ClearBuffer(&u8g2);
	u8g2_DrawLine(&u8g2, 0, 8, 127, 8);
	u8g2_DrawStr(&u8g2, 31, 8, "RaiderForge");
	u8g2_DrawFrame(&u8g2, 17, 11, 3, 4);
	u8g2_DrawXBM(&u8g2, 15, 12, 8, 17, image_Layer_5_bits);
	u8g2_DrawXBM(&u8g2, 15, 23, 8, 5, image_Layer_6_bits);
    u8g2_DrawStr(&u8g2, 26, 19, ext_buf);   /* live hotend actual/target  */
    u8g2_DrawStr(&u8g2, 26, 29, bed_buf);   /* live bed    actual/target  */
	u8g2_DrawXBM(&u8g2, 2, 49, 14, 16, image_micro_sd_bits);
	u8g2_DrawLine(&u8g2, 0, 46, 127, 46);
	u8g2_DrawXBM(&u8g2, 1, 30, 15, 16, image_clock_bits);
	u8g2_DrawStr(&u8g2, 34, 39, "50 / 60 mins");
	u8g2_DrawLine(&u8g2, 18, 41, 18, 44);
	u8g2_DrawLine(&u8g2, 18, 44, 119, 44);
	u8g2_DrawLine(&u8g2, 119, 44, 119, 41);
	u8g2_DrawLine(&u8g2, 19, 41, 119, 41);
	u8g2_DrawStr(&u8g2, 18, 61, "Example.gcode");
	u8g2_SendBuffer(&u8g2);
}

//------------------------------------------------------------------------------------------------------------------------------------------------
//MENU


//used to show the menu screen
void menu_display(){
	u8g2_ClearBuffer(&u8g2);
	u8g2_DrawLine(&u8g2, 0, 8, 127, 8);
	//icons
	u8g2_DrawXBM(&u8g2, 4,   24, 12, 16, image_operation_undo_bits);
	u8g2_DrawXBM(&u8g2, 22,  24, 16, 16, image_menu_settings_gear_bits);
	u8g2_DrawXBM(&u8g2, 40,  24, 16, 16, image_download_bits);
	u8g2_DrawXBM(&u8g2, 58,  24, 15, 16, image_download_1_bits);
	u8g2_DrawXBM(&u8g2, 76,  24, 15, 16, image_download_2_bits);
	u8g2_DrawXBM(&u8g2, 94,  24, 11, 16, image_crossed_bits);
	u8g2_DrawXBM(&u8g2, 112, 24, 12, 16, image_download_3_bits);
	//Selection box
	u8g2_DrawXBM(&u8g2, sel_box_x[menu_sel], 22, 21, 21, image_Layer_11_bits);


	u8g2_DrawStr(&u8g2, 16, 8, "Select an Option");
	//this needs to change!!! to say what the icon is
	//u8g2_DrawStr(&u8g2, 29, 53, "Home Printer");
	u8g2_DrawStr(&u8g2, 29, 53, sel_names[menu_sel]);
	u8g2_SendBuffer(&u8g2);

	//this also needs to return what was selection
}

//This updates the menu
int8_t menu_update_from_encoder(TIM_HandleTypeDef *htim)
{
    int16_t current_cnt = (int16_t)__HAL_TIM_GET_COUNTER(htim);
    int16_t diff = current_cnt - last_cnt;
    const int16_t base_count = 2;
    int8_t encoder_moved = 0;

    if (diff >= base_count) {
        menu_sel++;

        if (menu_sel >= MENU_COUNT) menu_sel = 0;
        last_cnt = current_cnt;   // lock to current count after step
        encoder_moved = 1;
    }
    else if (diff <= -base_count) {
        menu_sel--;
        if (menu_sel < 0) menu_sel = MENU_COUNT - 1;
        last_cnt = current_cnt;
        encoder_moved = 1;
    }

    return encoder_moved;
}


//---------------------------------------------------------------------------------------------------------------------------------------------------
//boot screen stuff

//used to show the boot screen
void boot_display(){
	u8g2_ClearBuffer(&u8g2);
	u8g2_DrawXBM(&u8g2, 22, 13, 85, 38, RaiderForgeLogo);
	u8g2_SendBuffer(&u8g2);
}
